&kscan0 {
    diode-direction = "col2row";

    col-gpios
        = <&gpio0 9  GPIO_ACTIVE_HIGH>
        , <&gpio0 19 GPIO_ACTIVE_HIGH>
        , <&gpio0 28 GPIO_ACTIVE_HIGH>
        , <&gpio1 1  GPIO_ACTIVE_HIGH>
        , <&gpio0 29 GPIO_ACTIVE_HIGH>
        , <&gpio1 7  GPIO_ACTIVE_HIGH>
        , <&gpio0 5  GPIO_ACTIVE_HIGH>
        ;

    row-gpios
        = <&gpio0 3  (GPIO_ACTIVE_HIGH | GPIO_PULL_DOWN)>
        , <&gpio0 15 (GPIO_ACTIVE_HIGH | GPIO_PULL_DOWN)>
        , <&gpio1 5  (GPIO_ACTIVE_HIGH | GPIO_PULL_DOWN)>
        , <&gpio0 4  (GPIO_ACTIVE_HIGH | GPIO_PULL_DOWN)>
        , <&gpio1 3  (GPIO_ACTIVE_HIGH | GPIO_PULL_DOWN)>
        ;
};
