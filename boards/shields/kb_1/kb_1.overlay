#include "kb_1.dtsi"
#include <input/processors.dtsi>
#include <dt-bindings/zmk/input_transform.h>

&pointing_listener {
    input-processors = <&zip_xy_transform (INPUT_TRANSFORM_X_INVERT | INPUT_TRANSFORM_Y_INVERT)>;

    scroll_listener {
        layers = <2>;
        // Apply additional scaling after driver acceleration.
        input-processors = <&zip_xy_scaler 2 5>
                         , <&zip_xy_to_scroll_mapper>
                         , <&zip_scroll_transform INPUT_TRANSFORM_Y_INVERT>;
    };
};

/* GPIO diagnostic owns CS/SCLK/SDIO directly. Disable the regular PAW3222
 * driver for this build only so two drivers never contend for the FFC bus. */
&spi2 {
    status = "disabled";
};
