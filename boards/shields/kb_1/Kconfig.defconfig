## boards/shields/kb_1/Kconfig.defconfig
```kconfig
if SHIELD_KB_1

config ZMK_KEYBOARD_NAME
    default "kb-1"

config SPI
    default y

config INPUT
    default y

config ZMK_MOUSE
    default y
 
config PAW3222_SMART_SCROLL
    default y

config PAW3222_BASE_SENSITIVITY_PERCENT
    default 5

config PAW3222_SCROLL_SENSITIVITY
    default 2

endif
```

## config/west.yml
```yaml
manifest:
  remotes:
    - name: zmkfirmware
      url-base: https://github.com/zmkfirmware
  projects:
    - name: zmk
      remote: zmkfirmware
      revision: v0.3
      import: app/west.yml
    - name: zmk-driver-paw3222
      url: https://github.com/beryu/zmk-driver-paw3222-kb-1
      revision: db5bb6460bbd4b7ceae6c73edd404045bc2dbded
  self:
    path: config
```
